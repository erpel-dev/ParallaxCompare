AUTOSAR XML (schema 4.0)
package /ActiveEcuC
  module config Can: ecuc-def-edition=4.4.0, implementation-config-variant=VARIANT-POST-BUILD, post-build-variant-used=true
    CanConfigSet
      CanCtrl_Body (CanController): CanControllerId=0, CanControllerBaudRate=500
  module config Spi: implementation-config-variant=VARIANT-PRE-COMPILE, module-description=Spi_Impl
    SpiGeneral: SpiLevelDelivered=2
package /Mcal
  module config Port: implementation-config-variant=VARIANT-PRE-COMPILE
    PortGeneral: PortDevErrorDetect=false
