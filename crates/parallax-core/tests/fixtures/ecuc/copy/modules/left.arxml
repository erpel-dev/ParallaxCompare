AUTOSAR XML (schema 4.0)
package /ActiveEcuC
  module config Can: implementation-config-variant=VARIANT-PRE-COMPILE
    CanConfigSet
      CanCtrl_Body (CanController): CanControllerId=0, CanControllerBaudRate=500
  module config Dio: implementation-config-variant=VARIANT-PRE-COMPILE
    DioConfig: DioPortId=1
package /Mcal
  module config Port: implementation-config-variant=VARIANT-PRE-COMPILE
    PortGeneral: PortDevErrorDetect=true
