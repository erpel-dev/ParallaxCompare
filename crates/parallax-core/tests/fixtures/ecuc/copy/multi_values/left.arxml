AUTOSAR XML (schema 4.0)
package /ActiveEcuC
  module config Com: implementation-config-variant=VARIANT-PRE-COMPILE
    Gen (ComGeneral): ComSupportedIpdu=1, ComSupportedIpdu=2, ComSupportedIpdu=3, ComMode=A, ComList=x, ComList=y
