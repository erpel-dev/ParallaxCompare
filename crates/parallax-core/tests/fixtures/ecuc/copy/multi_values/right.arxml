AUTOSAR XML (schema 4.0)
package /ActiveEcuC
  module config Com: implementation-config-variant=VARIANT-PRE-COMPILE
    Gen (ComGeneral): ComSupportedIpdu=2, ComSupportedIpdu=3, ComSupportedIpdu=4, ComMode=A, ComMode=B, ComList=x
