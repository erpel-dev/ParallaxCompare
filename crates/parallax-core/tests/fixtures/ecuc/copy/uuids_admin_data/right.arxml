AUTOSAR XML (schema 4.0)
package /ActiveEcuC
  module config Can: implementation-config-variant=VARIANT-PRE-COMPILE
    CanConfigSet
      CanCtrl_Body (CanController): CanControllerId=5, CanControllerBaudRate=500
      CanCtrl_Comfort (CanController): CanControllerId=1, CanControllerBaudRate=500
