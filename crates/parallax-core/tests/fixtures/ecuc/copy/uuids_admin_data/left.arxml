AUTOSAR XML (schema 4.0)
package /ActiveEcuC
  module config Can: implementation-config-variant=VARIANT-PRE-COMPILE
    CanConfigSet
      CanCtrl_Body (CanController): CanControllerId=0, CanControllerBaudRate=500
      CanCtrl_Chassis (CanController): CanControllerId=1, CanControllerBaudRate=500
