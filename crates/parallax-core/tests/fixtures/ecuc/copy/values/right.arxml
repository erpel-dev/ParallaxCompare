AUTOSAR XML (schema 4.0)
package /ActiveEcuC
  module config Can: implementation-config-variant=VARIANT-PRE-COMPILE
    General (CanGeneral):
      CanIndex = 4
      CanTimeoutDuration = 2.5E-3
      CanDevErrorDetect = false
      CanWakeupSupport = 0
      CanMainFunctionMode = INTERRUPT
      CanVendorString = it's > 'x'
      CanHookName = Can_Hook2
      CanMask = 0x20
