AUTOSAR XML (schema 4.0)
package /ActiveEcuC
  module config Can: implementation-config-variant=VARIANT-PRE-COMPILE
    General (CanGeneral):
      CanIndex = 3
      CanTimeoutDuration = 0.001
      CanDevErrorDetect = true
      CanWakeupSupport = 1
      CanMainFunctionMode = POLLING
      CanVendorString = a < b & "c"
      CanHookName = Can_Hook
      CanMask = 0x1F
