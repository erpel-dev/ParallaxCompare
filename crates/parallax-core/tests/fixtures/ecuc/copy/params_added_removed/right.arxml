AUTOSAR XML (schema 4.0)
package /ActiveEcuC
  module config Can: implementation-config-variant=VARIANT-PRE-COMPILE
    General (CanGeneral): CanDevErrorDetect=true, CanPrescaler=1.5, CanOwner=ECU1
