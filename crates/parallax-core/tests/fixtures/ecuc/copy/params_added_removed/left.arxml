AUTOSAR XML (schema 4.0)
package /ActiveEcuC
  module config Can: implementation-config-variant=VARIANT-PRE-COMPILE
    General (CanGeneral): CanIndex=1, CanDevErrorDetect=true
