AUTOSAR XML (schema 4.0)
package /ActiveEcuC
  module config EcuC: implementation-config-variant=VARIANT-PRE-COMPILE
    EcucPduCollection
      Pdu1 (Pdu): PduLength=8
    Empty (EcucConfigSet)
