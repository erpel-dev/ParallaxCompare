AUTOSAR XML (schema 4.0)
package /ActiveEcuC
  module config Nest: implementation-config-variant=VARIANT-PRE-COMPILE
    A (L1): P=1
      B (L2)
        C (L3): Q=2
          D (L4): R=deep
