AUTOSAR XML (schema 4.0)
package /ActiveEcuC
  module config Os: implementation-config-variant=VARIANT-PRE-COMPILE
    Task_A (OsTask): index=1, OsTaskPriority=1
    Task_B (OsTask): index=2, OsTaskPriority=2
