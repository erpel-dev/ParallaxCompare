AUTOSAR XML (schema 4.0)
package /ActiveEcuC
  module config Can: implementation-config-variant=VARIANT-PRE-COMPILE
    CanConfigSet
      25 x CanController:
        CanCtrl_00: CanControllerId=0, CanControllerBaudRate=800
        CanCtrl_01: CanControllerId=1, CanControllerBaudRate=125
        CanCtrl_02: CanControllerId=2, CanControllerBaudRate=125
        CanCtrl_03: CanControllerId=3, CanControllerBaudRate=1000
        CanCtrl_05: CanControllerId=5, CanControllerBaudRate=1000
        CanCtrl_06: CanControllerId=6, CanControllerBaudRate=125
        CanCtrl_07: CanControllerId=7, CanControllerBaudRate=125
        CanCtrl_08: CanControllerId=8, CanControllerBaudRate=500
          Br (CanControllerBaudrateConfig): CanControllerPropSeg=1
        CanCtrl_09: CanControllerId=9, CanControllerBaudRate=250
        CanCtrl_12_new: CanControllerId=12, CanControllerBaudRate=500
        CanCtrl_13: CanControllerId=13, CanControllerBaudRate=800
        CanCtrl_14: CanControllerId=14, CanControllerBaudRate=500
        CanCtrl_15_new: CanControllerId=15, CanControllerBaudRate=500
        CanCtrl_16: CanControllerId=16, CanControllerBaudRate=125
        CanCtrl_17: CanControllerId=17, CanControllerBaudRate=1000
        CanCtrl_18: CanControllerId=18, CanControllerBaudRate=500
        CanCtrl_19_new: CanControllerId=19, CanControllerBaudRate=500
        CanCtrl_20: CanControllerId=20, CanControllerBaudRate=800
        CanCtrl_21: CanControllerId=21, CanControllerBaudRate=250
        CanCtrl_22: CanControllerId=22, CanControllerBaudRate=1000
        CanCtrl_23: CanControllerId=23, CanControllerBaudRate=125
        CanCtrl_25: CanControllerId=25, CanControllerBaudRate=800
        CanCtrl_26_new: CanControllerId=26, CanControllerBaudRate=500
        CanCtrl_28_new: CanControllerId=28, CanControllerBaudRate=500
        CanCtrl_29_new: CanControllerId=29, CanControllerBaudRate=500
