AUTOSAR XML (schema 4.0)
package /ActiveEcuC
  module config Can: implementation-config-variant=VARIANT-PRE-COMPILE
    CanConfigSet
      CanCtrl_Body (CanController): CanControllerId=0, CanCpuClockRef=Clk, CanWakeupSourceRef=W1, CanWakeupSourceRef=W2
