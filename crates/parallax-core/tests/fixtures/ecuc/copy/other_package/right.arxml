AUTOSAR XML (schema 4.0)
package /EcucValues
  module config Can: implementation-config-variant=VARIANT-PRE-COMPILE
    CanConfigSet
      CanCtrl_Body (CanController): CanControllerId=1, CanControllerBaudRate=500, CanCpuClockRef=Clk
