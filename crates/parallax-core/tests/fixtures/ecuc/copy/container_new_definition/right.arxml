AUTOSAR XML (schema 4.0)
package /ActiveEcuC
  module config Can: implementation-config-variant=VARIANT-PRE-COMPILE
    CanConfigSet
      CanCtrl_Body (CanController): CanControllerId=0, CanControllerBaudRate=500
      Hoh_Rx0 (CanHardwareObject): CanObjectId=0, CanHandleType=FULL, CanObjectType=RECEIVE, CanControllerRef=CanCtrl_Body
        Filter0 (CanHwFilter): CanHwFilterCode=256, CanHwFilterMask=2047
