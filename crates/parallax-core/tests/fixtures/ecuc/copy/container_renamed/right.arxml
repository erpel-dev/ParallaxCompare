AUTOSAR XML (schema 4.0)
package /ActiveEcuC
  module config Can: implementation-config-variant=VARIANT-PRE-COMPILE
    CanConfigSet
      3 x CanController:
        CanCtrl_Body: CanControllerId=0, CanControllerBaudRate=500
        CanCtrl_Comfort: CanControllerId=1, CanControllerBaudRate=500
        CanCtrl_Powertrain: CanControllerId=2, CanControllerBaudRate=250
