AUTOSAR XML (schema 4.0)
package /ActiveEcuC
  module config Can: implementation-config-variant=VARIANT-PRE-COMPILE
    CanConfigSet
      3 x CanController, all with CanControllerBaudRate=500:
        CanCtrl_Body: CanControllerId=0
        CanCtrl_Chassis: CanControllerId=1
        CanCtrl_Powertrain: CanControllerId=2
