AUTOSAR XML (schema 4.0)
package /ActiveEcuC
  module config Rte: implementation-config-variant=VARIANT-PRE-COMPILE
    Inst (RteSwComponentInstance): RteDataRef=Root.Swc2.Data2
