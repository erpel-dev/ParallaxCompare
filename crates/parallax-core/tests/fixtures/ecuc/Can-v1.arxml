AUTOSAR XML (schema 4.0)
package /ActiveEcuC
  module config Can: implementation-config-variant=VARIANT-PRE-COMPILE
    CanConfigSet
      CanController_0 (CanController): CanControllerId=0x1F, CanControllerActivation=1, CanRxProcessing=INTERRUPT, CanCpuClockRef=Clk
