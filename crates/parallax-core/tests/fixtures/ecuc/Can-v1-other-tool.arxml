AUTOSAR XML (schema 4.0)
package /EcucValues
  module config Can: implementation-config-variant=VARIANT-PRE-COMPILE
    CanConfigSet
      CanController_0 (CanController): CanControllerActivation=true, CanControllerId=31, CanRxProcessing=INTERRUPT, CanCpuClockRef=Clk
