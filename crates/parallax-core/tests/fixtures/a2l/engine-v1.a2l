ASAP2_VERSION 1 71
/begin PROJECT EngineDemo "Engine ECU demo project"
/begin HEADER "Demo header" VERSION "V1.4.0" PROJECT_NO EDC42 /end HEADER
/begin MODULE ENGINE_ECU "Engine control"
/begin MOD_PAR "ECU parameters" VERSION "SW 1.4.0" ADDR_EPK 0x80000000 EPK "EDC42_V1.4.0 2026-10-01" SUPPLIER "Demo Automotive" CUSTOMER "Demo OEM" CPU_TYPE "TC397" ECU "EDC42" NO_OF_INTERFACES 1
 SYSTEM_CONSTANT "CYLINDERS" "4"
 SYSTEM_CONSTANT "SAMPLE_RATE_MS" "10"
 /begin MEMORY_SEGMENT Cal "Calibration data" DATA FLASH INTERN 0x80010000 0x10000 -1 -1 -1 -1 -1 /end MEMORY_SEGMENT
 /begin MEMORY_SEGMENT Ram "Working RAM" VARIABLES RAM INTERN 0xD0000000 0x8000 -1 -1 -1 -1 -1 /end MEMORY_SEGMENT
/end MOD_PAR
/begin MOD_COMMON "Common settings" DEPOSIT ABSOLUTE BYTE_ORDER MSB_LAST ALIGNMENT_BYTE 1 ALIGNMENT_WORD 2 ALIGNMENT_LONG 4 ALIGNMENT_FLOAT32_IEEE 4 /end MOD_COMMON
/begin IF_DATA XCP
 /begin PROTOCOL_LAYER 0x0104 0x07D0 0x2710 0x0000 0x0000 0x0000 0x0000 0x0000 0xFC 0xFC BYTE_ORDER_MSB_LAST ADDRESS_GRANULARITY_BYTE OPTIONAL_CMD GET_COMM_MODE_INFO OPTIONAL_CMD SET_MTA OPTIONAL_CMD UPLOAD /end PROTOCOL_LAYER
 /begin DAQ DYNAMIC 0 2 0 OPTIMISATION_TYPE_DEFAULT ADDRESS_EXTENSION_FREE IDENTIFICATION_FIELD_TYPE_ABSOLUTE GRANULARITY_ODT_ENTRY_SIZE_DAQ_BYTE 0xF8 OVERLOAD_INDICATION_PID /begin EVENT "10ms" "10ms" 0 DAQ 0xFF 10 6 0 /end EVENT /begin EVENT "100ms" "100ms" 1 DAQ 0xFF 100 6 0 /end EVENT /end DAQ
/end IF_DATA
/* ---------- Calibration ---------- */
/begin CHARACTERISTIC K_IdleSpeed "Idle speed setpoint" VALUE 0x80010000 RL_VALUE_UW 0 CM_Speed 500 1500 EXTENDED_LIMITS 0 3000 DISPLAY_IDENTIFIER IdleSpeed /end CHARACTERISTIC
/begin CHARACTERISTIC KL_IgnitionAdvance "Ignition advance over speed" CURVE 0x80010100 RL_CURVE_UW 0 CM_Ident -10 60 /begin AXIS_DESCR STD_AXIS nEngine CM_Speed 8 0 7000 DEPOSIT ABSOLUTE /end AXIS_DESCR /end CHARACTERISTIC
/begin CHARACTERISTIC KF_FuelMap "Injection quantity over speed and load" MAP 0x80010200 RL_MAP_UW 0 CM_Ident 0 100
 /begin AXIS_DESCR COM_AXIS nEngine CM_Speed 8 0 7000 AXIS_PTS_REF AX_EngineSpeed /end AXIS_DESCR
 /begin AXIS_DESCR STD_AXIS tCoolant CM_Temp 6 -40 140 /end AXIS_DESCR
 CALIBRATION_ACCESS CALIBRATION /end CHARACTERISTIC
/begin CHARACTERISTIC K_Mode "Operating mode" VALUE 0x80010010 RL_VALUE_UW 0 CM_Mode 0 2 /end CHARACTERISTIC
/begin AXIS_PTS AX_EngineSpeed "Shared engine speed axis" 0x80010300 nEngine RL_AXIS_UW 0 CM_Speed 8 0 7000 DEPOSIT ABSOLUTE MONOTONY STRICT_INCREASE /end AXIS_PTS
/* ---------- Measurement ---------- */
/begin MEASUREMENT nEngine "Engine speed" UWORD CM_Speed 0 0 0 7000 ECU_ADDRESS 0xD0001000 /end MEASUREMENT
/begin MEASUREMENT tCoolant "Coolant temperature" UBYTE CM_Temp 0 0 -40 215 ECU_ADDRESS 0xD0001002 /end MEASUREMENT
/begin MEASUREMENT B_Running "Engine running" UBYTE CM_Ident 0 0 0 1 BIT_MASK 0x01 ECU_ADDRESS 0xD0001004 DISCRETE /end MEASUREMENT
/* ---------- Conversions ---------- */
/begin COMPU_METHOD CM_Ident "Identity" IDENTICAL "%6.2" "" /end COMPU_METHOD
/begin COMPU_METHOD CM_Speed "Engine speed" LINEAR "%6.0" "rpm" COEFFS_LINEAR 0.25 0 /end COMPU_METHOD
/begin COMPU_METHOD CM_Temp "Temperature" RAT_FUNC "%6.1" "degC" COEFFS 0 1 40 0 0 1 /end COMPU_METHOD
/begin COMPU_METHOD CM_Mode "Mode" TAB_VERB "%2.0" "" COMPU_TAB_REF VT_Mode /end COMPU_METHOD
/begin COMPU_VTAB VT_Mode "Operating modes" TAB_VERB 3 0 "Off" 1 "On" 2 "Limp home" DEFAULT_VALUE "invalid" /end COMPU_VTAB
/begin RECORD_LAYOUT RL_VALUE_UW FNC_VALUES 1 UWORD COLUMN_DIR DIRECT /end RECORD_LAYOUT
/begin RECORD_LAYOUT RL_CURVE_UW NO_AXIS_PTS_X 1 UWORD AXIS_PTS_X 2 UWORD INDEX_INCR DIRECT FNC_VALUES 3 UWORD COLUMN_DIR DIRECT /end RECORD_LAYOUT
/begin RECORD_LAYOUT RL_MAP_UW NO_AXIS_PTS_X 1 UWORD NO_AXIS_PTS_Y 2 UWORD AXIS_PTS_X 3 UWORD INDEX_INCR DIRECT AXIS_PTS_Y 4 UWORD INDEX_INCR DIRECT FNC_VALUES 5 UWORD COLUMN_DIR DIRECT /end RECORD_LAYOUT
/begin RECORD_LAYOUT RL_AXIS_UW NO_AXIS_PTS_X 1 UWORD AXIS_PTS_X 2 UWORD INDEX_INCR DIRECT /end RECORD_LAYOUT
/begin FUNCTION F_Ignition "Ignition timing" FUNCTION_VERSION "2.1" /begin DEF_CHARACTERISTIC K_IdleSpeed KL_IgnitionAdvance /end DEF_CHARACTERISTIC /begin IN_MEASUREMENT nEngine tCoolant /end IN_MEASUREMENT /begin OUT_MEASUREMENT B_Running /end OUT_MEASUREMENT /end FUNCTION
/begin GROUP G_Engine "Engine group" ROOT /begin REF_CHARACTERISTIC KF_FuelMap K_IdleSpeed KL_IgnitionAdvance K_Mode /end REF_CHARACTERISTIC /begin REF_MEASUREMENT nEngine tCoolant /end REF_MEASUREMENT /end GROUP
/begin UNIT U_rpm "revolutions per minute" "rpm" DERIVED SI_EXPONENTS 0 0 -1 0 0 0 0 /end UNIT
/end MODULE
/end PROJECT
